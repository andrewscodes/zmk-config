## config/west.yml
```yaml
manifest:
  remotes:
    - name: zmkfirmware
      url-base: https://github.com/zmkfirmware
    - name: infely
      url-base: https://github.com/infely  
    # nice_oled
    # - name: mctechnology17
    #   url-base: https://github.com/mctechnology17
    # bongo cat
    # - name: ANDRESDEV-CO
    #   url-base: https://github.com/ANDRESDEV-CO
  projects:
    - name: zmk
      remote: zmkfirmware
      revision: main
      import: app/west.yml
    - name: nice-view-battery
      remote: infely
      revision: main
    # nice_oled
    # - name: zmk-nice-oled
    #   remote: mctechnology17
    #   revision: main
    # bongo cat
    # - name: nice-view-mod
    #   remote: ANDRESDEV-CO
    #   revision: custom-animation
  self:
    path: config
```
